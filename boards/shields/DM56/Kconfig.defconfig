## boards/shields/DM56/Kconfig.defconfig
```kconfig
if SHIELD_DM56_LEFT

    config ZMK_KEYBOARD_NAME
        default "DM56"

    config ZMK_SPLIT_BLE_ROLE_CENTRAL
        default y
endif

if SHIELD_DM56_RIGHT

    config ZMK_KEYBOARD_NAME
        default "DM56 Right"

endif

if SHIELD_DM56_LEFT || SHIELD_DM56_RIGHT

    config ZMK_SPLIT
        default y

endif
```

## boards/shields/DM56/Kconfig.shield
```kconfig
config SHIELD_DM56_LEFT
    def_bool $(shields_list_contains,DM56_left)

config SHIELD_DM56_RIGHT
    def_bool $(shields_list_contains,DM56_right)
```
